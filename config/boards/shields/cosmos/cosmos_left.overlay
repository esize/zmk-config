#include "cosmos.dtsi" // Notice that the main dtsi files are included in the overlay.

&kscan0 {
    col-gpios = <&pro_micro 5 GPIO_ACTIVE_HIGH>, // Col 0 in the schematic
                <&pro_micro 6 GPIO_ACTIVE_HIGH>, // Col 1 in the schematic
                <&pro_micro 7 GPIO_ACTIVE_HIGH>, // Col 2 in the schematic
                <&pro_micro 8 GPIO_ACTIVE_HIGH>, // Col 3 in the schematic
                <&pro_micro 9 GPIO_ACTIVE_HIGH>; // Col 4 in the schematic
};