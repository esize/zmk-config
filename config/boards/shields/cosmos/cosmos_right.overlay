#include "cosmos.dtsi"

&default_transform { // The matrix transform for this board is 5 pro_micro over because the left half is 5 pro_micro wide according to the matrix.
    col-offset = <5>;
};

&kscan0 {
    col-gpios = <&pro_micro 5 GPIO_ACTIVE_HIGH>, // Col 5 in the schematic
                <&pro_micro 6 GPIO_ACTIVE_HIGH>, // Col 6 in the schematic
                <&pro_micro 7 GPIO_ACTIVE_HIGH>, // Col 7 in the schematic
                <&pro_micro 8 GPIO_ACTIVE_HIGH>, // Col 8 in the schematic
                <&pro_micro 9 GPIO_ACTIVE_HIGH>; // Col 9 in the schematic
};